## Kconfig
```kconfig
# SPDX-License-Identifier: MIT

if ZMK_POINTING

config ZMK_INPUT_PROCESSOR_STICKY_TEMP_LAYER
    bool "Sticky Temporary Layer Input Processor"
    default y
    depends on DT_HAS_ZMK_INPUT_PROCESSOR_STICKY_TEMP_LAYER_ENABLED
    help
      ZMK 標準の temp-layer 入力プロセッサに「excluded-positions に挙げた
      キーを押しても無効化タイマーを延長する」挙動を追加したもの。
      ボールを止めたままレイヤー上のキーを操作し続けてもレイヤーが
      落ちなくなる。

config ZMK_INPUT_PROCESSOR_STICKY_TEMP_LAYER_MAX_ACTION_EVENTS
    int "Sticky Temporary Layer Input Processor Max Action Events"
    default 4
    depends on ZMK_INPUT_PROCESSOR_STICKY_TEMP_LAYER

endif # ZMK_POINTING
```

## config/west.yml
```yaml
manifest:
  remotes:
    - name: zmkfirmware
      url-base: https://github.com/zmkfirmware
    - name: sekigon-gonnoc  # <-- PAW3222
      url-base: https://github.com/sekigon-gonnoc
    - name: caksoylar  # <-- RGB LED
      url-base: https://github.com/caksoylar
    - name: gohanda11  # <-- Threshold Temp Layer
      url-base: https://github.com/gohanda11
  # revision は全て SHA で固定する。
  # ブランチ名 (v0.3-branch / main) のままだと、同じ config コミットから
  # ビルドしても毎回別のファームになり、設定を1項目ずつ変える比較ができない。
  # 更新するときは意図して SHA を差し替え、何を上げたかコミットに残す。
  projects:
    - name: zmk
      remote: zmkfirmware
      revision: acfd8e5ea76cf23ad1c9b6b99848f97a95224257  # v0.3-branch @ 2026-11-25
      import: app/west.yml
    - name: zmk-driver-paw3222
      remote: sekigon-gonnoc
      revision: df652881be2520bde4f64ab6ca35e4c5708f4f9b  # main @ 2026-11-25
    - name: zmk-rgbled-widget
      remote: caksoylar
      revision: 8756cb7b8114069fa3c25c6f6c990f24988fceff  # v0.3-branch @ 2026-11-25
    - name: zmk-input-processor-threshold-temp-layer
      remote: gohanda11
      revision: a68fedf50dd3b25d7aa594776c26b943fe41cfbf  # main @ 2026-11-25
  self:
    path: config
```

## dts/bindings/zmk,input-processor-sticky-temp-layer.yaml
```yaml
# SPDX-License-Identifier: MIT

description: |
  Input Processor for temporarily enabling a layer after input events.

  Behaves like zmk,input-processor-temp-layer, except that pressing or
  releasing a key listed in excluded-positions also extends the layer's
  deactivation timeout instead of merely not cancelling it.

compatible: "zmk,input-processor-sticky-temp-layer"

include: ip_two_param.yaml

properties:
  require-prior-idle-ms:
    type: int
    required: false
    default: 0
    description: |
      Time in milliseconds that must pass after the last keystroke before the
      layer can be toggled.

  activation-threshold:
    type: int
    required: false
    default: 0
    description: |
      Minimum accumulated movement (in sensor counts) required before the layer
      activates. X and Y arrive as separate events, so the accumulation is a
      Manhattan sum. 0 disables the threshold, activating on any movement.

  accumulation-timeout-ms:
    type: int
    required: false
    default: 0
    description: |
      Discard the accumulated movement if no movement arrives for this long.
      0 never discards, which lets small drifts add up until the threshold is
      eventually crossed. Only meaningful with activation-threshold set.

  excluded-positions:
    type: array
    required: false
    default: []
    description: |
      Array of key positions that will NOT trigger layer deactivation when
      pressed. These positions extend the layer timeout instead.
```
